/**
 * @cliArgs --board "/ti/boards/LP_MSPM0G3507" --product "mspm0_sdk@2.08.00.03"
 * @versions {"tool":"1.21.0+3721"}
 */

/**
 * Import the modules used in this configuration.
 */
const Board  = scripting.addModule("/ti/driverlib/Board");
const GPIO   = scripting.addModule("/ti/driverlib/GPIO", {}, false);
const GPIO1  = GPIO.addInstance();
const I2C    = scripting.addModule("/ti/driverlib/I2C", {}, false);
const I2C1   = I2C.addInstance();
const SPI    = scripting.addModule("/ti/driverlib/SPI", {}, false);
const SPI1   = SPI.addInstance();
const SYSCTL = scripting.addModule("/ti/driverlib/SYSCTL");

/**
 * Write custom configuration values to the imported modules.
 */
Board.peripheral.$assign          = "DEBUGSS";
Board.peripheral.swclkPin.$assign = "j25_expansion.16";
Board.peripheral.swdioPin.$assign = "j25_expansion.14";

GPIO1.$name                          = "GPIO_GRP_0";
GPIO1.associatedPins.create(2);
GPIO1.associatedPins[0].$name        = "CS_n";
GPIO1.associatedPins[0].initialValue = "SET";
GPIO1.associatedPins[0].pin.$assign  = "boosterpack.8";
GPIO1.associatedPins[1].$name        = "DRDYn";
GPIO1.associatedPins[1].direction    = "INPUT";
GPIO1.associatedPins[1].polarity     = "FALL";
GPIO1.associatedPins[1].ioStructure  = "SD";
GPIO1.associatedPins[1].pin.$assign  = "boosterpack.4";

I2C1.$name                           = "I2C_0";
I2C1.basicEnableController           = true;
I2C1.enableDMAEvent1                 = false;
I2C1.enableDMAEvent2                 = false;
I2C1.basicControllerStandardBusSpeed = "Fast";
I2C1.peripheral.$assign              = "I2C1";
I2C1.peripheral.sdaPin.$assign       = "boosterpack.10";
I2C1.peripheral.sclPin.$assign       = "boosterpack.9";
I2C1.sdaPinConfig.$name              = "ti_driverlib_gpio_GPIOPinGeneric4";
I2C1.sclPinConfig.$name              = "ti_driverlib_gpio_GPIOPinGeneric5";

SPI1.$name                      = "SPI_0";
SPI1.phase                      = "1";
SPI1.chipSelect                 = ["3"];
SPI1.frameFormat                = "MOTO3";
SPI1.targetBitRate              = 800000;
SPI1.peripheral.$assign         = "SPI0";
SPI1.peripheral.sclkPin.$assign = "boosterpack.25";
SPI1.peripheral.mosiPin.$assign = "boosterpack.18";
SPI1.peripheral.misoPin.$assign = "boosterpack.23";
SPI1.sclkPinConfig.$name        = "ti_driverlib_gpio_GPIOPinGeneric0";
SPI1.mosiPinConfig.$name        = "ti_driverlib_gpio_GPIOPinGeneric1";
SPI1.misoPinConfig.$name        = "ti_driverlib_gpio_GPIOPinGeneric2";

SYSCTL.clockTreeEn = true;

const ProjectConfig              = scripting.addModule("/ti/project_config/ProjectConfig", {}, false);
ProjectConfig.migrationCondition = true;
